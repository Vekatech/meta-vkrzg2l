## conf/layer.conf
```bitbake
# We have a conf and classes directory, add to BBPATH
BBPATH .= ":${LAYERDIR}"

# We have recipes-* directories, add to BBFILES
BBFILES += "${LAYERDIR}/recipes-*/*/*.bbappend \
            ${LAYERDIR}/recipes-*/*/*/*.bb \
            ${LAYERDIR}/recipes-*/*/*/*.bbappend \
        "

BBFILE_COLLECTIONS += "vkrzg2l"
BBFILE_PATTERN_vkrzg2l = "^${LAYERDIR}/"
BBFILE_PRIORITY_vkrzg2l = "17"

LAYERDEPENDS_vkrzg2l = "rz-common rzg2l"
LAYERSERIES_COMPAT_vkrzg2l = "dunfell"

HOSTTOOLS += "xz"
```

## conf/machine/vkrzg2l.conf
```bitbake
#@TYPE: Machine
#@NAME: Vekatech VKRZG2L machine
#@DESCRIPTION: RZ/G2L platform

OVERRIDES_append = ":vkrzg2l"
SOC_FAMILY = "r9a07g044l"
require conf/machine/include/rzg2l-common.inc
require conf/machine/include/cip-core.inc

DEFAULTTUNE ?= "cortexa55"

TUNE_CONF ?= "conf/machine/include/tune-cortexa55.inc"
require ${TUNE_CONF}

PREFERRED_PROVIDER_virtual/kernel="linux-renesas"

UBOOT_CONFIG ??= "vkrzg2l"
UBOOT_CONFIG[vkrzg2l] = "vkrzg2l_defconfig"
#UBOOT_CONFIG[vkrzg2l] = "vkrzg2l-sf_defconfig"

# flash writer
EXTRA_IMAGEDEPENDS += " flash-writer"

# Supported devicetree
KERNEL_DEVICETREE = " renesas/vkrzg2l.dtb"

KERNEL_DEVICETREE_OVERLAY  = " \
	renesas/overlays/vkrz-cm33.dtbo \
	renesas/overlays/vkrz-csi-imx219.dtbo \
	renesas/overlays/vkrz-dsi-hdmi.dtbo \
	renesas/overlays/vkrz-dsi-av_disp2.dtbo \
	renesas/overlays/vkrz-dsi-vklcd-ee0700.dtbo \
	renesas/overlays/vkrz-dsi-vklcd07.dtbo \
	renesas/overlays/vkrz-exp-pwm0.dtbo \
	renesas/overlays/vkrz-exp-pwm1.dtbo \
	renesas/overlays/vkrz-exp-pwm2.dtbo \
	renesas/overlays/vkrz-exp-riic2.dtbo \
	renesas/overlays/vkrz-exp-rspi1.dtbo \
	renesas/overlays/vkrz-exp-scif2.dtbo \
	renesas/overlays/vkrz-exp-scif2_rts_cts.dtbo \
	renesas/overlays/vkrz-sdhi0-emmc.dtbo \
	renesas/overlays/vkrz-sdhi0-sdhi.dtbo \
"

BSP_SOC = "RZG2L"
BSP_BOARD = "VK-RZ/G2L-v2.0"

#ENABLE_SPD_OPTEE = '1'
#ENABLE_RZ_SCE    = '1'


IMAGE_BOOT_FILES = " \
	bl2_bp-${MACHINE}.srec \
	fip-${MACHINE}.srec \
	Flash_Writer_SCIF_VKRZG2L_DDR4_2GB_1PCS.mot \
"
# generate wic image
IMAGE_FSTYPES_append = " wic wic.bz2"
IMAGE_BOOT_FILES += " Image vkrzg2l.dtb"

# Deploy the uEnv.txt to the /boot directory
WKS_FILE_DEPENDS_append = " uenv"
IMAGE_BOOT_FILES += "uEnv.txt"
IMAGE_BOOT_FILES += "readme.txt"

# Support DTB Overlay files
IMAGE_BOOT_FILES += " overlays/*;overlays/"
#IMAGE_BOOT_FILES += " cm33/*;cm33/"

WKS_DEFAULT_FILE = "image-vkrzg2l-mmc0.wks"

# Ship kernel modules
MACHINE_ESSENTIAL_EXTRA_RRECOMMENDS_append = " kernel-modules"
```
